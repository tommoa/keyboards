## feral/split-reset/Kconfig
```kconfig
config FERAL_SPLIT_RESET_ON_START
    bool "Feral split reset firmware"
    default n
    depends on SETTINGS && ZMK_BLE
    help
      Build a dedicated Feral split-reset image that clears only split pairing
      state for the selected half on startup.
```

## feral/startup-led/Kconfig
```kconfig
config FERAL_RGBLED_STATUS
    bool "Feral XIAO RGB status LED support"
    default n
    depends on GPIO
    help
      Drive the onboard XIAO RGB LED for Feral status indications.

config FERAL_RGBLED_STATUS_STARTUP_BLINK
    bool "Blink XIAO LED on startup"
    default y
    depends on FERAL_RGBLED_STATUS
    help
      Blink the onboard XIAO red LED briefly during startup.

config FERAL_RGBLED_STATUS_BATTERY_BLINK_ON_MS
    int "Battery blink on duration in milliseconds"
    default 180
    depends on FERAL_RGBLED_STATUS
    help
      How long each battery blink stays lit.

config FERAL_RGBLED_STATUS_BATTERY_BLINK_OFF_MS
    int "Battery blink off duration in milliseconds"
    default 180
    depends on FERAL_RGBLED_STATUS
    help
      How long each battery blink stays dark between pulses.
```

## feral/startup-led/dts/bindings/behaviors/zmk,behavior-feral-battery-indicator.yaml
```yaml
# Copyright (c) 2026 Tom Almeida
# SPDX-License-Identifier: MIT

description: Feral battery indicator behavior
compatible: "zmk,behavior-feral-battery-indicator"
include: zero_param.yaml
```

## zmk/feral/config/boards/shields/feral/Kconfig.defconfig
```kconfig
if SHIELD_FERAL

config ZMK_KEYBOARD_NAME
    default "Feral"

endif

if SHIELD_FERAL_LEFT

config ZMK_KEYBOARD_NAME
    default "Feral"

config ZMK_SPLIT_ROLE_CENTRAL
    default y

config ZMK_SPLIT_BLE_CENTRAL_PERIPHERALS
    default 1

endif

if SHIELD_FERAL_LEFT || SHIELD_FERAL_RIGHT

config ZMK_SPLIT
    default y

endif
```

## zmk/feral/config/boards/shields/feral/Kconfig.shield
```kconfig
config SHIELD_FERAL
    def_bool $(shields_list_contains,feral)

config SHIELD_FERAL_LEFT
    def_bool $(shields_list_contains,feral_left)

config SHIELD_FERAL_RIGHT
    def_bool $(shields_list_contains,feral_right)
```

## zmk/feral/config/boards/shields/feral_diag/Kconfig.defconfig
```kconfig
if SHIELD_FERAL_DIAG

config ZMK_KEYBOARD_NAME
    default "Feral Diag C2R"

endif
```

## zmk/feral/config/boards/shields/feral_diag_rev/Kconfig.defconfig
```kconfig
if SHIELD_FERAL_DIAG_REV

config ZMK_KEYBOARD_NAME
    default "Feral Diag R2C"

endif
```

## zmk/feral/config/boards/shields/feral_diag_rev/Kconfig.shield
```kconfig
config SHIELD_FERAL_DIAG_REV
    def_bool $(shields_list_contains,feral_diag_rev)
```

## zmk/feral/config/boards/shields/feral_split_reset/Kconfig.defconfig
```kconfig
if SHIELD_FERAL_SPLIT_RESET_LEFT

config ZMK_KEYBOARD_NAME
    default "Feral Reset L"

config ZMK_USB
    default n

config ZMK_DISPLAY
    default n

endif

if SHIELD_FERAL_SPLIT_RESET_RIGHT

config ZMK_KEYBOARD_NAME
    default "Feral Reset R"

config ZMK_USB
    default n

config ZMK_DISPLAY
    default n

endif
```

## zmk/feral/config/boards/shields/feral_split_reset/Kconfig.shield
```kconfig
config SHIELD_FERAL_SPLIT_RESET_LEFT
    def_bool $(shields_list_contains,feral_split_reset_left)

config SHIELD_FERAL_SPLIT_RESET_RIGHT
    def_bool $(shields_list_contains,feral_split_reset_right)
```

## zmk/feral/connectpro/west.yml
```yaml
manifest:
  remotes:
    - name: zmkfirmware
      url-base: https://github.com/zmkfirmware
    - name: tommoa
      url-base: https://github.com/tommoa
  projects:
    - name: zmk
      remote: tommoa
      revision: 1f78a0fe71a2eb3a0e0911a92070bb7a6f271c1b # usb-hid-device-indexes, zmkfirmware/zmk#3345
      import: app/west.yml
    - name: zephyr
      remote: zmkfirmware
      revision: ec36516990d40355238db3049bc1709191f99b4e # v4.1.0+zmk-fixes
      import:
        name-blocklist:
          - ci-tools
          - hal_altera
          - hal_cypress
          - hal_infineon
          - hal_microchip
          - hal_nxp
          - hal_openisa
          - hal_silabs
          - hal_xtensa
          - hal_st
          - hal_ti
          - loramac-node
          - mcuboot
          - mcumgr
          - net-tools
          - openthread
          - edtt
          - trusted-firmware-m
  self:
    path: feral/connectpro
```
