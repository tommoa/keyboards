#include <dt-bindings/zmk/matrix_transform.h>

/ {
    chosen {
        zmk,kscan = &split_reset_kscan;
    };

    split_reset_kscan: split_reset_kscan {
        compatible = "zmk,kscan-mock";
        columns = <1>;
        rows = <0>;
        events = <>;
    };
};
